/ {
    &kscan {
        compatible = "zmk,kscan-gpio-direct";
        label = "KSCAN";
        input-gpios
            = <&gpio 3 (GPIO_ACTIVE_LOW | GPIO_PULL_UP)>
            , <&gpio 4 (GPIO_ACTIVE_LOW | GPIO_PULL_UP)>
            , <&gpio 5 (GPIO_ACTIVE_LOW | GPIO_PULL_UP)>
            , <&gpio 6 (GPIO_ACTIVE_LOW | GPIO_PULL_UP)>
            , <&gpio 26 (GPIO_ACTIVE_LOW | GPIO_PULL_UP)>
            , <&gpio 27 (GPIO_ACTIVE_LOW | GPIO_PULL_UP)>
            , <&gpio 28 (GPIO_ACTIVE_LOW | GPIO_PULL_UP)>
            , <&gpio 29 (GPIO_ACTIVE_LOW | GPIO_PULL_UP)>
            ;
        debounce-press-ms = <0>;
        debounce-release-ms = <2>;

        zmk,matrix-transform = <0 1 2 3 4 5 6 7>;
    };
};

/ {
    &studio_unlock
};